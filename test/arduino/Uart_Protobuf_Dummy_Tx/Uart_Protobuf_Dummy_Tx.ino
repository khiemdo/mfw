/*!
 The circuit:
 * RX is digital pin 10 (connect to TX of other device)
 * TX is digital pin 11 (connect to RX of other device)
 * Baudrate: 115200 8-N-1
 */
 
int leetMessageOverSerialProto[] = {0xA5, 0x00, 0x02, 0x13, 0x37, 0x5A, 0x5A};

int pbBetConfMessageOverSerialProto [] = 
{
  0xA5,                                            // Serial proto SYNC
  0x00, 0x94,                                      // Serial proto length
  0x93, 0x01, 0x0A, 0x14, 0x0A, 0x06, 0x08, 0x01,  // Serial proto payload = pb_betCONF
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  0x5A, 0x5A                                        // Serial proto CRC
};

int testData [] =
{
0xA5, 
0x00, 0x94, 
0x00, 0x01, 0x02, 0x03, 0x04, 0x05, 0x06, 0x07,
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0x90, 0x91, 0x92, 0x93, 0x5A, 0x5A 
};

int i;
int messageToSend; // 1=leet, 2=leet, 3=pb_BetCONF
int loopCounter;

/* ================== START OF USER DEFINES =====================  */

/* \brief Defines the number of messages to transmit. */
#define MAX_LOOP_COUNT   10000

/* \brief Defines the number of messages to transmit.
   
   \warning IMPORTANT! Keep this value in sync with the
            corresponding baud rate! E.g. when setting
            this value to 5ms (= 200Hz) you should set
            the baudrate to 1000000 (= 1MBit/s).
            Otherwise the data rate is to slow for the
            TX intervall.
*/
#define TX_INTERVALL_MS    5

/* \brief Defines the baudrate for the serial port.
          Up to 1MBit/s (= 1000000) is supported.
          
   \warning IMPORTANT! Keep this value in sync with the
            TX intervall!
*/
#define SERIAL_BAUD_RATE   1000000

/* ================== END OF USER DEFINES =====================  */

void setup()
{
  // Open serial communications and wait for port to open:
  Serial.begin(SERIAL_BAUD_RATE);
  while (!Serial) {
    ; // wait for serial port to connect. Needed for Leonardo only
  }

  i = 0;
  messageToSend = 1;
  loopCounter = 0;
}

void loop() // run over and over
{
  delay(TX_INTERVALL_MS);

  if( messageToSend == 1 )
  {
    messageToSend = 2;
    for(i=0; i < (sizeof(leetMessageOverSerialProto) / sizeof(int)); i++ )
    {
      Serial.write( leetMessageOverSerialProto[i] );
    }
  }
   else if( messageToSend == 2 )
  {
    messageToSend = 3;
    for(i=0; i < (sizeof(leetMessageOverSerialProto) / sizeof(int)); i++ )
    {
      Serial.write( leetMessageOverSerialProto[i] );
    }
  }
  else
  {
    messageToSend = 1;
    for(i=0; i < (sizeof(pbBetConfMessageOverSerialProto) / sizeof(int)); i++ )
    {
      Serial.write( pbBetConfMessageOverSerialProto[i] );
    }

    /* Use the following piece of code to transmit test dummy data with
       payload from 0x00 ... 0x93. */
    //for(i=0; i < (sizeof(testData) / sizeof(int)); i++ )
    //{
    //  Serial.write( testData[i] );
    //}
  }

  loopCounter++;

  if(loopCounter == MAX_LOOP_COUNT)
  {
    /* Stop here after we send out all messages. */
    while(1);
  }
}

